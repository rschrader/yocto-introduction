## meta-yocto-introduction/conf/layer.conf
```bitbake
# We have a conf and classes directory, add to BBPATH
BBPATH .= ":${LAYERDIR}"

# We have recipes-* directories, add to BBFILES
BBFILES += "${LAYERDIR}/recipes-*/*/*.bb \
            ${LAYERDIR}/recipes-*/*/*.bbappend"

BBFILE_COLLECTIONS += "meta-yocto-introduction"
BBFILE_PATTERN_meta-yocto-introduction = "^${LAYERDIR}/"
BBFILE_PRIORITY_meta-yocto-introduction = "6"

LAYERDEPENDS_meta-yocto-introduction = "core"
LAYERSERIES_COMPAT_meta-yocto-introduction = "warrior zeus"

IMAGE_INSTALL_append = "hello-world"
```
